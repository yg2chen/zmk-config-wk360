## config/boards/shields/fish/Kconfig.defconfig
```kconfig
# Copyright (c) 2021 The ZMK Contributors
# SPDX-License-Identifier: MIT


if SHIELD_WK_KINESIS_360_LEFT
# 右親機にしたければ "if SHIELD_WK_KINESIS_360_RIGHT" にする

config ZMK_KEYBOARD_NAME
    default "wk_kinesis_360 Keyboard"

config ZMK_SPLIT_ROLE_CENTRAL
    default y

endif


if SHIELD_WK_KINESIS_360_LEFT || SHIELD_WK_KINESIS_360_RIGHT

config ZMK_SPLIT
    default y

endif
```

## config/boards/shields/fish/Kconfig.shield
```kconfig
# Copyright (c) 2021 The ZMK Contributors
# SPDX-License-Identifier: MIT

config SHIELD_WK_KINESIS_360_LEFT
    def_bool $(shields_list_contains,wk_kinesis_360_left)

config SHIELD_WK_KINESIS_360_RIGHT
    def_bool $(shields_list_contains,wk_kinesis_360_right)
```

## config/boards/shields/wk360/Kconfig.defconfig
```kconfig
# Copyright (c) 2021 The ZMK Contributors
# SPDX-License-Identifier: MIT


if SHIELD_WKS360_LEFT
# 右親機にしたければ "if SHIELD_WK_360_RIGHT" にする

config ZMK_KEYBOARD_NAME
    default "WK 360 Wireless"

config ZMK_SPLIT_ROLE_CENTRAL
    default y

endif


if SHIELD_WK360_LEFT || SHIELD_WK_RIGHT

config ZMK_SPLIT
    default y

endif
```

## config/boards/shields/wk360/Kconfig.shield
```kconfig
# Copyright (c) 2021 The ZMK Contributors
# SPDX-License-Identifier: MIT

config SHIELD_WK360_LEFT
    def_bool $(shields_list_contains,wk360_left)

config SHIELD_WK360_RIGHT
    def_bool $(shields_list_contains,wk360_right)
```

## config/boards/shields/wk_kinesis/Kconfig.defconfig
```kconfig
# Copyright (c) 2021 The ZMK Contributors
# SPDX-License-Identifier: MIT


if SHIELD_WK_KINESIS_LEFT

config ZMK_KEYBOARD_NAME
    default "WK Kinesis BLE"

config ZMK_SPLIT_ROLE_CENTRAL
    default y

endif


if SHIELD_WK_KINESIS_LEFT || SHIELD_WK_KINESIS_RIGHT

config ZMK_SPLIT
    default y

endif
```

## config/boards/shields/wk_kinesis/Kconfig.shield
```kconfig
# Copyright (c) 2021 The ZMK Contributors
# SPDX-License-Identifier: MIT

config SHIELD_WK_KINESIS_LEFT
    def_bool $(shields_list_contains,wk_kinesis_left)

config SHIELD_WK_KINESIS_RIGHT
    def_bool $(shields_list_contains,wk_kinesis_right)
```
